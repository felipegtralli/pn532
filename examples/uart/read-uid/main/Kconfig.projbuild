## examples/uart/read-uid/main/Kconfig.projbuild
```kconfig
menu "Example Configuration"

    config UART_TX_GPIO_PIN
        int "TX pin"
        default 17
        help
            Select the TX pin for UART.
    
    config UART_RX_GPIO_PIN
        int "RX pin"
        default 16
        help
            Select the RX pin for UART.

    config UART_PORT
        int "UART port"
        default 0
        help
            Select the UART port.
    
endmenu
```
